/*
 * Copyright (c) 2020 Pete Johanson
 *
 * SPDX-License-Identifier: MIT
 */

#include "cornix.dtsi"
#include "trackball_L.dtsi"
&kscan0 {
    compatible = "zmk,kscan-gpio-matrix";
    row-gpios
        = <&gpio1 13 (GPIO_ACTIVE_HIGH | GPIO_PULL_DOWN)>
        , <&gpio0 28 (GPIO_ACTIVE_HIGH | GPIO_PULL_DOWN)>
        , <&gpio0 3  (GPIO_ACTIVE_HIGH | GPIO_PULL_DOWN)>
        , <&gpio1 11 (GPIO_ACTIVE_HIGH | GPIO_PULL_DOWN)>
        ;
    col-gpios
        = <&gpio0 15 GPIO_ACTIVE_HIGH>
        , <&gpio0 17 GPIO_ACTIVE_HIGH>
        , <&gpio0 20 GPIO_ACTIVE_HIGH>
        , <&gpio0 22 GPIO_ACTIVE_HIGH>
        , <&gpio1 0  GPIO_ACTIVE_HIGH>
        , <&gpio1 2  GPIO_ACTIVE_HIGH>
        , <&gpio0 10 GPIO_ACTIVE_HIGH>
        ;
};

&left_encoder {
    status = "okay";
};