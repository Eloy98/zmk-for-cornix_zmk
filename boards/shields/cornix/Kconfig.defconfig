## boards/shields/cornix/Kconfig.defconfig
```kconfig
if SHIELD_CORNIX_L

config ZMK_KEYBOARD_NAME
	default "Cornix"

config ZMK_SPLIT_BLE_ROLE_CENTRAL
	default y

endif

if SHIELD_CORNIX_L || SHIELD_CORNIX_R

config ZMK_SPLIT
    default y

config ZMK_POINTING
    default y

config PAW3222
    default y
    
endif
```

## boards/shields/cornix/Kconfig.shield
```kconfig
# Copyright (c) 2020 Pete Johanson
# SPDX-License-Identifier: MIT

config SHIELD_CORNIX_L
	def_bool $(shields_list_contains,cornix_L)

config SHIELD_CORNIX_R
	def_bool $(shields_list_contains,cornix_R)
```
